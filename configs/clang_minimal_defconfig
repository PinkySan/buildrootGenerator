## configs/clang_minimal_defconfig
```kconfig
# Minimal Buildroot defconfig for Clang cross-compilation with SSH
# Place this file in configs/ as required by the prompt

# Target architecture (example: aarch64)
BR2_aarch64=y

# Use external toolchain (Clang must be installed on the host, not built by Buildroot)
BR2_TOOLCHAIN_EXTERNAL=y
BR2_TOOLCHAIN_EXTERNAL_CUSTOM=y
BR2_TOOLCHAIN_EXTERNAL_DOWNLOAD=n
BR2_TOOLCHAIN_EXTERNAL_PATH="/usr"
BR2_TOOLCHAIN_EXTERNAL_PREFIX="aarch64-linux-gnu"
BR2_TOOLCHAIN_EXTERNAL_HEADERS_4_19=y
BR2_TOOLCHAIN_EXTERNAL_CXX=y
BR2_TOOLCHAIN_EXTERNAL_CUSTOM_CLANG=y
BR2_TOOLCHAIN_EXTERNAL_CUSTOM_CLANG_PATH="/usr/bin/clang"

# No kernel build
BR2_LINUX_KERNEL=n

# Minimal rootfs
BR2_TARGET_ROOTFS_CPIO=y
BR2_TARGET_ROOTFS_TAR=y

# SSH support (dropbear for minimal footprint)
BR2_PACKAGE_DROPBEAR=y

# Minimal busybox
BR2_PACKAGE_BUSYBOX=y

# Sysroot generation (handled by Buildroot during rootfs build)

# End of defconfig
```

## configs/clang_sysroot_armhf_defconfig
```kconfig
# Zielarchitektur: ARM 32-bit mit Hard Float ABI
BR2_arm=y
BR2_ARM_EABIHF=y
BR2_ARM_FPU_VFPV3=y
BR2_GCC_TARGET_ABI="hf"

# Verwende Clang (Host) + Buildroot glibc Sysroot
BR2_TOOLCHAIN_BUILDROOT=y
BR2_TOOLCHAIN_BUILDROOT_USE_CLANG=y
BR2_TOOLCHAIN_BUILDROOT_CXX=y
BR2_TOOLCHAIN_BUILDROOT_GLIBC=y


# Development-Dateien für Sysroot
BR2_DEVELOPMENT_FILES=y
BR2_STATIC_LIBS=y
BR2_ENABLE_DEBUG=n
BR2_DEBUG_SYM_LINK=n
BR2_STRIP_strip=y

# Systemkonfiguration
BR2_TARGET_GENERIC_GETTY_PORT="ttyAMA0"
BR2_SYSTEM_DEFAULT_PATH="/bin:/sbin:/usr/bin:/usr/sbin"

# BusyBox (Shell etc.)
BR2_PACKAGE_BUSYBOX=y

# SSH-Server: OpenSSH
BR2_PACKAGE_OPENSSH=y
BR2_PACKAGE_OPENSSH_CLIENT=y
BR2_PACKAGE_OPENSSH_SERVER=y
BR2_PACKAGE_OPENSSH_KEY_UTILS=y

# RootFS: nur tar
BR2_TARGET_ROOTFS_TAR=y

# Tools und Header für Cross-Compiling mit Clang
BR2_PACKAGE_PKGCONF=y        
BR2_PACKAGE_LIBC_DEVFILES=y
```

## configs/rpi4_aarch64_systemd_defconfig
```kconfig
# Zielarchitektur: AArch64 / ARMv8-A (64-bit)
BR2_aarch64=y
BR2_cortex_a72=y
BR2_ARM_FPU_VFPV4D16=y

# glibc als Standard-C-Bibliothek
BR2_TOOLCHAIN_BUILDROOT_GLIBC=y

# C++-Unterstützung aktivieren
BR2_TOOLCHAIN_BUILDROOT_CXX=y
BR2_INSTALL_LIBSTDCPP=y
BR2_TOOLCHAIN_BUILDROOT_WCHAR=y

# Export eines verwendbaren Sysroots für Crossbuilds
BR2_PACKAGE_HOST_TOOLCHAIN_EXTRACT_SYSROOT=y

# systemd als Init-System
BR2_INIT_SYSTEMD=y
BR2_PACKAGE_SYSTEMD=y
BR2_SYSTEM_DHCP="eth0"
BR2_TARGET_GENERIC_GETTY_PORT="ttyAMA0"
BR2_TARGET_GENERIC_GETTY_BAUDRATE_115200=y

# Disable Linux Kernel build
# BR2_LINUX_KERNEL is commented out to avoid building the kernel
# BR2_LINUX_KERNEL=y
# BR2_LINUX_KERNEL_CUSTOM_VERSION=y
# BR2_LINUX_KERNEL_CUSTOM_VERSION_VALUE="6.5"
# BR2_LINUX_KERNEL_DEFCONFIG="bcm2711"
# BR2_LINUX_KERNEL_DTS_SUPPORT=y
# BR2_LINUX_KERNEL_INTREE_DTS_NAME="broadcom/bcm2711-rpi-4-b"

# Disable U-Boot Bootloader build
# BR2_TARGET_UBOOT is commented out to avoid building U-Boot
# BR2_TARGET_UBOOT=y
# BR2_TARGET_UBOOT_BOARD_DEFCONFIG="rpi_4"
# BR2_TARGET_UBOOT_CUSTOM_VERSION=y
# BR2_TARGET_UBOOT_CUSTOM_VERSION_VALUE="2023.10"
# BR2_TARGET_UBOOT_FORMAT_IMG=y
# BR2_TARGET_UBOOT_BOARDNAME="rpi_4"

# Raspberry Pi Firmware (für Boot-Partition)
BR2_PACKAGE_RPI_FIRMWARE=y
BR2_PACKAGE_RPI_FIRMWARE_INSTALL_DTB_OVERLAYS=y
BR2_PACKAGE_RPI_FIRMWARE_INSTALL_CMDS=y

# RootFS: ext4 + tar + bootfähiges SD-Image
BR2_ROOTFS_EXT2=y
BR2_ROOTFS_EXT2_4=y
BR2_ROOTFS_EXT2_SIZE="512M"
BR2_TARGET_ROOTFS_TAR=y
BR2_TARGET_SDIMAGE=y
BR2_TARGET_SDIMAGE_BOOT_PARTITION=y
BR2_TARGET_SDIMAGE_BOOT_PARTITION_FILES="bcm2711-rpi-4-b.dtb boot.scr zImage overlays/"

# Ensure SSH access via Dropbear remains enabled
BR2_PACKAGE_DROPBEAR=y

# Nützliche Tools
BR2_PACKAGE_HTOP=y
BR2_PACKAGE_NANO=y
BR2_PACKAGE_GDB=y

# Netzwerk-Tools
BR2_PACKAGE_NFTABLES=y
BR2_PACKAGE_NFTABLES_PYTHON=n
```
